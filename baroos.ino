l /**************************************************************************/
/*!
    @file     baroos.cpp
    @author   M. Jeffery (Student)
    @license  BSD (see license.txt)

    Barometer Operating System for RCC

    This is a basic operating system for a simple barometer using the Freescale MPL3115A2 sensor,
    building on the libraries provided by Adafruit Industries.

    @section  HISTORY

    v0.1 - First Alpha
*/
/**************************************************************************/

#include <Wire.h>
#include <Adafruit_MPL3115A2.h>
#include <Adafruit_SSD1306.h>

#define ABUTTON      12
#define BBUTTON      6
#define CBUTTON      5

#define PU_PASCALS   0
#define PU_ATM       1
#define PU_TORR      2
#define PU_INHG      3
#define PU_MBAR      4

#define TU_CELSIUS   0
#define TU_KELVIN    1
#define TU_FARENHEIT 2

#define BAROUPDATE   100

// Power by connecting Vin to 3-5V, GND to GND
// Uses I2C - connect SCL to the SCL pin, SDA to SDA pin
// See the Wire tutorial for pinouts for each Arduino
// http://arduino.cc/en/reference/wire
Adafruit_MPL3115A2 baro = Adafruit_MPL3115A2();
Adafruit_SSD1306 display = Adafruit_SSD1306();

int pressure_unit = 0;
int temp_unit = 0;

unsigned long elapsed = 0;
unsigned long lastmillis = 0;

float pascals = 0;
float altm = 0;
float tempC = 0;

int abuttonlaststate = HIGH;
int bbuttonlaststate = HIGH;
unsigned long abuttonlastpress = 0;
unsigned long bbuttonlastpress = 0;

unsigned long debouncedelay = 200;

const unsigned char Splash [] PROGMEM = {
  // 'Splash'
  0x00, 0x00, 0x00, 0x00, 0x00, 0x00, 0x40, 0x00, 0x00, 0x00, 0x00, 0x00, 0x80, 0xf8, 0x03, 0xe0, 
  0x00, 0x00, 0x00, 0x00, 0x00, 0x00, 0x40, 0x00, 0x00, 0x00, 0x00, 0x01, 0x00, 0xfc, 0x07, 0xe0, 
  0x38, 0x00, 0x00, 0x00, 0x00, 0x02, 0x64, 0x20, 0x00, 0x00, 0x00, 0x01, 0x00, 0xfe, 0x0f, 0xe0, 
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  0x00, 0x00, 0x00, 0x00, 0x00, 0x00, 0x00, 0x00, 0x00, 0x00, 0x3f, 0xff, 0x80, 0x00, 0x00, 0x00, 
};


void setup() {
  lastmillis = millis();
  Serial.begin(9600);
  pinMode(ABUTTON, INPUT_PULLUP);
  pinMode(BBUTTON, INPUT_PULLUP);
  pinMode(CBUTTON, INPUT_PULLUP);
  
  display.begin(SSD1306_SWITCHCAPVCC, 0x3C);
  display.clearDisplay();
  display.display();  
  display.drawBitmap(0, 0, Splash, 128, 32, WHITE);
  display.display();
  delay(2000);  
}

void loop() {


  elapsed = millis() - lastmillis;
  lastmillis = millis();
  
  //Read button states
  int abuttonstate = digitalRead(ABUTTON);
  int bbuttonstate = digitalRead(BBUTTON);
  
  if (abuttonstate != abuttonlaststate)
  {
    abuttonlaststate = abuttonstate;
    abuttonlastpress = millis();
  }

  if (millis() - abuttonlastpress > debouncedelay)
  {
    if (abuttonlaststate == LOW)
    {
           
      pressure_unit += 1;
      if (pressure_unit > 4)
      {
        pressure_unit = 0;
      }
    }
    abuttonlastpress = millis();
  }
  
  if (bbuttonstate == LOW)
  {
    temp_unit += 1;
    if (temp_unit > 2)
    {
      temp_unit = 0;
    }
  }

  //Get battery voltage
  float batvol = analogRead(9);
  batvol *= 2;
  batvol *=3.3;
  batvol /= 1024;

  //Every BAROUPDATE milliseconds, update the data
  if (elapsed > BAROUPDATE)
  {
     
    elapsed = 0;
    
    if (! baro.begin()) {
      Serial.println("Couldnt find sensor");
      return;
    }
    float lastpascals = pascals;    
    pascals = baro.getPressure();
    altm = baro.getAltitude();
    Serial.print(altm); Serial.println(" meters");
  
    tempC = baro.getTemperature();
    Serial.print(tempC); Serial.println("*C");
    
  }
  display.clearDisplay();
  display.setCursor(0,0);
  display.setTextSize(1.5);
  display.setTextColor(WHITE);
  if(pressure_unit == PU_PASCALS)
  {
    display.print("KPa:");
    display.println(pascals/1000, 2);   
  }
  else if(pressure_unit == PU_ATM)
  {
    float atm = pascals*0.00000986923267;      
    display.print("Atm:");
    display.println(atm, 3);
  }
  else if(pressure_unit == PU_TORR)
  {
    float torr = pascals*0.00750062;      
    display.print("Torr:");
    display.println(torr, 3);
  }
  else if(pressure_unit == PU_INHG)
  {
    float inhg = pascals*0.0002953;      
    display.print("InHg:");
    display.println(inhg, 2);
  }
  else if(pressure_unit == PU_MBAR)
  {
    float mbar = pascals*0.01;      
    display.print("mb:");
    display.println(mbar, 1);
  }
  display.print("C: ");
  display.println(tempC, 2);
  display.display();
  
}
